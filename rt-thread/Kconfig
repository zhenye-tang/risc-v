## rt-thread/Kconfig
```kconfig
mainmenu "RT-Thread Configuration"

BSP_DIR := .

RTT_DIR := rt-thread

PKGS_DIR := packages

source "$(RTT_DIR)/Kconfig"
source "$PKGS_DIR/Kconfig"
source "board/Kconfig"
```

## rt-thread/board/Kconfig
```kconfig
menu "Hardware Drivers Config"

config SOC_QEMU_RV32
    bool
    select RT_USING_COMPONENTS_INIT
    select RT_USING_USER_MAIN
    default y

endmenu
```
